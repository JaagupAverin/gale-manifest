## west.yml
```yaml
manifest:
  version: "1.2"

  self:
    path: gale

  remotes:
    - name: origin
      url-base: https://github.com/JaagupAverin
    - name: nordic
      url-base: https://github.com/nrfconnect

  defaults:
    remote: origin
    revision: main

  projects:
    - name: gale-sensor-app
      path: sensor_app
    - name: gale-hmi-app
      path: hmi_app
    - name: gale-shared
      path: shared

    - name: sdk-nrf
      path: nrf
      remote: nordic
      west-commands: scripts/west-commands.yml
      import:
        path-allowlist:
          # Core dependencies:
          - zephyr
          - nrfxlib
          - hal/nordic
          - cmsis_6
          - libmetal
          - open-amp
          # Optional dependencies:
          - mcuboot
          - littlefs
          # BabbleSim:
          - bsim
          - bsim/components
          - bsim/components/*
          - nrf_hw_models

  group-filter: [+babblesim]
```
